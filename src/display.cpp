#include "display.h"

// 5x7 glyphs, columns LSB-at-top, ASCII 32..126.
// Only the characters used by this firmware are explicitly shaped;
// unknown glyphs fall back to a box.
static const uint8_t GLYPH_BOX[5] = {0x7F,0x41,0x41,0x41,0x7F};

struct GlyphDef { char c; uint8_t col[5]; };
static const GlyphDef GLYPHS[] = {
  {' ',{0,0,0,0,0}},
  {'!',{0,0,0x5F,0,0}},
  {'\"',{0,0x03,0,0x03,0}},
  {'#',{0x14,0x7F,0x14,0x7F,0x14}},
  {'$',{0x24,0x2A,0x7F,0x2A,0x12}},
  {'%',{0x23,0x13,0x08,0x64,0x62}},
  {'&',{0x36,0x49,0x55,0x22,0x50}},
  {'\'',{0,0x05,0x03,0,0}},
  {'(',{0,0x1C,0x22,0x41,0}},
  {')',{0,0x41,0x22,0x1C,0}},
  {'-',{0x08,0x08,0x08,0x08,0x08}},
  {'_',{0x40,0x40,0x40,0x40,0x40}},
  {'+',{0x08,0x08,0x3E,0x08,0x08}},
  {'*',{0x14,0x08,0x3E,0x08,0x14}},
  {',',{0,0x50,0x30,0,0}},
  {'.',{0,0,0x60,0x60,0}},
  {':',{0,0x36,0x36,0,0}},
  {';',{0,0x56,0x36,0,0}},
  {'<',{0x08,0x14,0x22,0x41,0}},
  {'=',{0x14,0x14,0x14,0x14,0x14}},
  {'>',{0,0x41,0x22,0x14,0x08}},
  {'?',{0x02,0x01,0x51,0x09,0x06}},
  {'[',{0,0x7F,0x41,0x41,0}},
  {'\\',{0x04,0x08,0x10,0x20,0x40}},
  {']',{0,0x41,0x41,0x7F}},
  {'^',{0x04,0x02,0x01,0x02,0x04}},
  {'@',{0x3E,0x41,0x5D,0x55,0x1E}},
  {'/',{0x40,0x20,0x10,0x08,0x04}},
  {'`',{0,0x01,0x02,0x04,0}},
  {'{',{0x08,0x36,0x41,0x41,0}},
  {'|',{0,0,0x7F,0,0}},
  {'}',{0,0x41,0x41,0x36,0x08}},
  {'~',{0x08,0x04,0x08,0x10,0x08}},
  {'0',{0x3E,0x51,0x49,0x45,0x3E}},
  {'1',{0,0x42,0x7F,0x40,0}},
  {'2',{0x42,0x61,0x51,0x49,0x46}},
  {'3',{0x21,0x41,0x45,0x4B,0x31}},
  {'4',{0x18,0x14,0x12,0x7F,0x10}},
  {'5',{0x27,0x45,0x45,0x45,0x39}},
  {'6',{0x3C,0x4A,0x49,0x49,0x30}},
  {'7',{0x01,0x71,0x09,0x05,0x03}},
  {'8',{0x36,0x49,0x49,0x49,0x36}},
  {'9',{0x06,0x49,0x49,0x29,0x1E}},
  {'A',{0x7E,0x11,0x11,0x11,0x7E}},
  {'B',{0x7F,0x49,0x49,0x49,0x36}},
  {'C',{0x3E,0x41,0x41,0x41,0x22}},
  {'D',{0x7F,0x41,0x41,0x22,0x1C}},
  {'E',{0x7F,0x49,0x49,0x49,0x41}},
  {'F',{0x7F,0x09,0x09,0x09,0x01}},
  {'G',{0x3E,0x41,0x49,0x49,0x7A}},
  {'H',{0x7F,0x08,0x08,0x08,0x7F}},
  {'I',{0,0x41,0x7F,0x41,0}},
  {'J',{0x20,0x40,0x41,0x3F,0x01}},
  {'K',{0x7F,0x08,0x14,0x22,0x41}},
  {'L',{0x7F,0x40,0x40,0x40,0x40}},
  {'M',{0x7F,0x02,0x0C,0x02,0x7F}},
  {'N',{0x7F,0x04,0x08,0x10,0x7F}},
  {'O',{0x3E,0x41,0x41,0x41,0x3E}},
  {'P',{0x7F,0x09,0x09,0x09,0x06}},
  {'Q',{0x3E,0x41,0x51,0x21,0x5E}},
  {'R',{0x7F,0x09,0x19,0x29,0x46}},
  {'S',{0x46,0x49,0x49,0x49,0x31}},
  {'T',{0x01,0x01,0x7F,0x01,0x01}},
  {'U',{0x3F,0x40,0x40,0x40,0x3F}},
  {'V',{0x1F,0x20,0x40,0x20,0x1F}},
  {'W',{0x3F,0x40,0x38,0x40,0x3F}},
  {'X',{0x63,0x14,0x08,0x14,0x63}},
  {'Y',{0x07,0x08,0x70,0x08,0x07}},
  {'Z',{0x61,0x51,0x49,0x45,0x43}},
  {'a',{0x20,0x54,0x54,0x54,0x78}},
  {'b',{0x7F,0x48,0x44,0x44,0x38}},
  {'c',{0x38,0x44,0x44,0x44,0x20}},
  {'d',{0x38,0x44,0x44,0x48,0x7F}},
  {'e',{0x38,0x54,0x54,0x54,0x18}},
  {'f',{0x08,0x7E,0x09,0x01,0x02}},
  {'g',{0x0C,0x52,0x52,0x52,0x3E}},
  {'h',{0x7F,0x08,0x04,0x04,0x78}},
  {'i',{0,0x44,0x7D,0x40,0}},
  {'j',{0x20,0x40,0x44,0x3D,0}},
  {'k',{0x7F,0x10,0x28,0x44,0}},
  {'l',{0,0x41,0x7F,0x40,0}},
  {'m',{0x7C,0x04,0x18,0x04,0x78}},
  {'n',{0x7C,0x08,0x04,0x04,0x78}},
  {'o',{0x38,0x44,0x44,0x44,0x38}},
  {'p',{0x7C,0x14,0x14,0x14,0x08}},
  {'q',{0x08,0x14,0x14,0x18,0x7C}},
  {'r',{0x7C,0x08,0x04,0x04,0x08}},
  {'s',{0x48,0x54,0x54,0x54,0x20}},
  {'t',{0x04,0x3F,0x44,0x40,0x20}},
  {'u',{0x3C,0x40,0x40,0x20,0x7C}},
  {'v',{0x1C,0x20,0x40,0x20,0x1C}},
  {'w',{0x3C,0x40,0x30,0x40,0x3C}},
  {'x',{0x44,0x28,0x10,0x28,0x44}},
  {'y',{0x0C,0x50,0x50,0x50,0x3C}},
  {'z',{0x44,0x64,0x54,0x4C,0x44}},
};

static const uint8_t* glyphFor(char c) {
  for (const auto& g : GLYPHS) if (g.c == c) return g.col;
  return GLYPH_BOX;
}

void ST7796Display::select() {
  digitalWrite(PIN_TOUCH_CS, HIGH);
  digitalWrite(PIN_TFT_CS, LOW);
}
void ST7796Display::deselect() { digitalWrite(PIN_TFT_CS, HIGH); }

void ST7796Display::cmd(uint8_t c) {
  spi_.beginTransaction(SPISettings(TFT_SPI_HZ, MSBFIRST, SPI_MODE0));
  select();
  digitalWrite(PIN_TFT_DC, LOW);
  spi_.transfer(c);
  deselect();
  spi_.endTransaction();
}
void ST7796Display::data(uint8_t d) {
  spi_.beginTransaction(SPISettings(TFT_SPI_HZ, MSBFIRST, SPI_MODE0));
  select();
  digitalWrite(PIN_TFT_DC, HIGH);
  spi_.transfer(d);
  deselect();
  spi_.endTransaction();
}
void ST7796Display::data16(uint16_t d) {
  spi_.beginTransaction(SPISettings(TFT_SPI_HZ, MSBFIRST, SPI_MODE0));
  select();
  digitalWrite(PIN_TFT_DC, HIGH);
  spi_.transfer(d >> 8);
  spi_.transfer(d & 0xFF);
  deselect();
  spi_.endTransaction();
}
void ST7796Display::resetPanel() {
  digitalWrite(PIN_TFT_RST, HIGH); delay(20);
  digitalWrite(PIN_TFT_RST, LOW); delay(120);
  digitalWrite(PIN_TFT_RST, HIGH); delay(200);
}

void ST7796Display::begin() {
  pinMode(PIN_TFT_CS, OUTPUT);
  pinMode(PIN_TFT_DC, OUTPUT);
  pinMode(PIN_TFT_RST, OUTPUT);
  digitalWrite(PIN_TFT_CS, HIGH);

  resetPanel();

  cmd(0x01); delay(150);        // SWRESET
  cmd(0x11); delay(120);        // SLEEPOUT
  cmd(0xF0); data(0xC3);
  cmd(0xF0); data(0x96);

  cmd(0x36); data(ST7796_MADCTL);
  cmd(0x3A); data(0x55);        // RGB565

  cmd(0xB4); data(0x01);
  cmd(0xB7); data(0xC6);

  cmd(0xE8);
  const uint8_t e8[] = {0x40,0x8A,0x00,0x00,0x29,0x19,0xA5,0x33};
  for (uint8_t v : e8) data(v);

  cmd(0xC1); data(0x06);
  cmd(0xC2); data(0xA7);
  cmd(0xC5); data(0x18);

  cmd(0xE0);
  const uint8_t pGamma[] = {0xF0,0x09,0x0B,0x06,0x04,0x15,0x2F,0x54,0x42,0x3C,0x17,0x14,0x18,0x1B};
  for (uint8_t v : pGamma) data(v);
  cmd(0xE1);
  const uint8_t nGamma[] = {0xE0,0x09,0x0B,0x06,0x04,0x03,0x2B,0x43,0x42,0x3B,0x16,0x14,0x17,0x1B};
  for (uint8_t v : nGamma) data(v);

  cmd(0xF0); data(0x3C);
  cmd(0xF0); data(0x69);
  cmd(0x20);                 // INVOFF
  cmd(0x13);                 // NORON
  cmd(0x29); delay(20);      // DISPON

  fillScreen(rgb565(16,18,22));
}


void ST7796Display::sleep() {
  cmd(0x28);       // DISPOFF
  delay(20);
  cmd(0x10);       // SLPIN
  delay(120);
}

void ST7796Display::wake() {
  cmd(0x11);       // SLPOUT
  delay(120);
  cmd(0x29);       // DISPON
  delay(20);
}

void ST7796Display::setWindow(int16_t x, int16_t y, int16_t w, int16_t h) {
  int16_t x1 = x + w - 1, y1 = y + h - 1;
  cmd(0x2A);
  spi_.beginTransaction(SPISettings(TFT_SPI_HZ, MSBFIRST, SPI_MODE0));
  select(); digitalWrite(PIN_TFT_DC, HIGH);
  spi_.transfer(x >> 8); spi_.transfer(x);
  spi_.transfer(x1 >> 8); spi_.transfer(x1);
  deselect(); spi_.endTransaction();

  cmd(0x2B);
  spi_.beginTransaction(SPISettings(TFT_SPI_HZ, MSBFIRST, SPI_MODE0));
  select(); digitalWrite(PIN_TFT_DC, HIGH);
  spi_.transfer(y >> 8); spi_.transfer(y);
  spi_.transfer(y1 >> 8); spi_.transfer(y1);
  deselect(); spi_.endTransaction();

  cmd(0x2C);
}

void ST7796Display::fillRect(int16_t x, int16_t y, int16_t w, int16_t h, uint16_t color) {
  if (w <= 0 || h <= 0 || x >= SCREEN_W || y >= SCREEN_H) return;
  if (x < 0) { w += x; x = 0; }
  if (y < 0) { h += y; y = 0; }
  if (x + w > SCREEN_W) w = SCREEN_W - x;
  if (y + h > SCREEN_H) h = SCREEN_H - y;
  if (w <= 0 || h <= 0) return;

  setWindow(x,y,w,h);
  spi_.beginTransaction(SPISettings(TFT_SPI_HZ, MSBFIRST, SPI_MODE0));
  select(); digitalWrite(PIN_TFT_DC, HIGH);
  uint32_t n = uint32_t(w) * uint32_t(h);
  uint8_t hi = color >> 8, lo = color & 0xFF;
  while (n--) { spi_.transfer(hi); spi_.transfer(lo); }
  deselect(); spi_.endTransaction();
}

void ST7796Display::fillScreen(uint16_t color) { fillRect(0,0,SCREEN_W,SCREEN_H,color); }

void ST7796Display::drawRect(int16_t x, int16_t y, int16_t w, int16_t h, uint16_t c) {
  fillRect(x,y,w,1,c); fillRect(x,y+h-1,w,1,c);
  fillRect(x,y,1,h,c); fillRect(x+w-1,y,1,h,c);
}

void ST7796Display::drawLine(int x0,int y0,int x1,int y1,uint16_t c) {
  int dx=abs(x1-x0), sx=x0<x1?1:-1;
  int dy=-abs(y1-y0), sy=y0<y1?1:-1, err=dx+dy;
  for (;;) {
    fillRect(x0,y0,1,1,c);
    if (x0==x1 && y0==y1) break;
    int e2=2*err;
    if (e2>=dy){err+=dy;x0+=sx;}
    if (e2<=dx){err+=dx;y0+=sy;}
  }
}
void ST7796Display::drawCircle(int x0,int y0,int r,uint16_t c) {
  int x=r,y=0,err=0;
  while(x>=y){
    fillRect(x0+x,y0+y,1,1,c);fillRect(x0+y,y0+x,1,1,c);
    fillRect(x0-y,y0+x,1,1,c);fillRect(x0-x,y0+y,1,1,c);
    fillRect(x0-x,y0-y,1,1,c);fillRect(x0-y,y0-x,1,1,c);
    fillRect(x0+y,y0-x,1,1,c);fillRect(x0+x,y0-y,1,1,c);
    if(err<=0){y++;err+=2*y+1;} if(err>0){x--;err-=2*x+1;}
  }
}
void ST7796Display::fillCircle(int x0,int y0,int r,uint16_t c) {
  for(int y=-r;y<=r;y++){
    int x=(int)sqrtf(float(r*r-y*y));
    fillRect(x0-x,y0+y,2*x+1,1,c);
  }
}

void ST7796Display::drawChar(int x,int y,char ch,uint16_t fg,uint16_t bg,int scale) {
  const uint8_t* g=glyphFor(ch);
  for(int cx=0;cx<5;cx++){
    uint8_t bits=g[cx];
    for(int cy=0;cy<7;cy++){
      fillRect(x+cx*scale,y+cy*scale,scale,scale,(bits&(1<<cy))?fg:bg);
    }
  }
  fillRect(x+5*scale,y,scale,7*scale,bg);
}
void ST7796Display::drawText(int x,int y,const String& s,uint16_t fg,uint16_t bg,int scale) {
  int cx=x;
  for(char ch:s){ drawChar(cx,y,ch,fg,bg,scale); cx += 6*scale; }
}

void ST7796Display::drawRGB565Masked(int x, int y, const uint16_t* pixels,
                                     const uint8_t* mask, int w, int h) {
  for (int yy=0; yy<h; ++yy) {
    int runStart=-1;
    for (int xx=0; xx<=w; ++xx) {
      bool on = false;
      if (xx<w) {
        int i=yy*w+xx;
        on = (mask[i>>3] >> (i&7)) & 1;
      }
      if (on && runStart<0) runStart=xx;
      if ((!on || xx==w) && runStart>=0) {
        int len=xx-runStart;
        setWindow(x+runStart,y+yy,len,1);
        spi_.beginTransaction(SPISettings(TFT_SPI_HZ,MSBFIRST,SPI_MODE0));
        select(); digitalWrite(PIN_TFT_DC,HIGH);
        for(int k=runStart;k<xx;k++){
          uint16_t c=pgm_read_word(&pixels[yy*w+k]);
          spi_.transfer(c>>8); spi_.transfer(c&0xFF);
        }
        deselect(); spi_.endTransaction();
        runStart=-1;
      }
    }
  }
}
